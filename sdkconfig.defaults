## sdkconfig.defaults
```kconfig
CONFIG_PARTITION_TABLE_CUSTOM=y
CONFIG_PARTITION_TABLE_CUSTOM_FILENAME="partitions2.csv"
CONFIG_PARTITION_TABLE_FILENAME="partitions2.csv"
CONFIG_COCO_DETECT_YOLO11N_320_S8_V3=y
CONFIG_COCO_DETECT_MODEL_IN_FLASH_PARTITION=y


CONFIG_ESPTOOLPY_FLASHSIZE_8MB=y


CONFIG_SPIRAM_MODE_OCT=y
CONFIG_SPIRAM_SPEED_80M=y
```
